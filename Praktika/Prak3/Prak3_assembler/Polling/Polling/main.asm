;
; Created: 24.10.2019 17:24:24
; Author : bh8332s
;

.include "m8def.inc"

.def State = r21		;0 -> nichts; 1 -> Led 0 togglen; 2 -> Led 1 togglen
.def tmpEORreg = r22	;um 0. Bit zu togglen

.org 0x000
	rjmp initialize

initialize:
    ldi r16, LOW(RAMEND)
    out SPL, r16
    ldi r16, HIGH(RAMEND)
    out SPH, r16

	ldi State, 0

    ldi r16, 0b00000011 ;LED 0,1 als Ausgang
    out DDRB, r16
    ldi r16, 0x00
    out DDRD, r16

    ldi r16, 0xFF
    out PORTD, r16              ;PullUps fuer Taster

main:
	rcall state_change

	cpi State, 0
	brne L2
	rcall delay_200ms
	rjmp main

L2:
	cpi State, 0b00000001
	breq toggleLED0
	
	cpi State, 0b00000010
	breq toggleLED1

	rjmp main


state_change:
	in r24, PIND

	ANDI r24, (1 << PD2)
	breq state_change_to1

	in r24, PIND	;sbis PIND, PD2

	ANDI r24, (1 << PD3)
	breq state_change_to2

	ret

state_change_to1:	; state == 0 -> LED0 togglen - state = 1; state != 0 -> LED0 aus - state = 0

	ldi r17, 0b00000001

	;State clearen
	ANDI State, 0b0000001

	eor State, r17

	ret

state_change_to2: ; state == 0 -> LED1 togglen - state = 2; state != 0 -> LED1 aus - state = 1

	ldi r17, 0b00000010

	;State clearen
	ANDI State, 0b00000010

	eor State, r17

	ret

toggleLED0:
	rcall onLED0
	rcall delay_200ms
	rcall offLED0
	rcall delay_200ms

	rjmp main

offLED0:
	in r16, PORTB
    ANDI r16, 0b11111110
	out PORTB, r16
    ret

onLED0:	;schaltet alle anderen aus
	ldi r16, 0b00000001
    out PORTB, r16
    ret



toggleLED1:
	rcall onLED1
	rcall delay_200ms
	rcall offLED1
	rcall delay_200ms

	rjmp main

offLED1:
	in r16, PORTB
    ANDI r16, 0b11111101
	out PORTB, r16
    ret

onLED1:	;schaltet alle anderen aus
	ldi r16, 0b00000010
    out PORTB, r16
    ret

delay_200ms:
; Generated by delay loop calculator
; at http://www.bretmulvey.com/avrdelay.html
;
; Delay 200 000 cycles
; 200ms at 1 MHz

    ldi  r18, 2
    ldi  r19, 4
    ldi  r20, 187
L1: dec  r20
    brne L1
    dec  r19
    brne L1
    dec  r18
    brne L1
    nop
	ret